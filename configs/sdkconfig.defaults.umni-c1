## sdkconfig.defaults
```kconfig
CONFIG_LOG_MAXIMUM_LEVEL=3
CONFIG_UMNI_FW_VERSION="1.0.0"
CONFIG_UM_FEATURE_ETHERNET=n
CONFIG_UM_FEATURE_WIFI=n
CONFIG_UM_FEATURE_SDCARD=n
CONFIG_UM_FEATURE_WEBSERVER=n
CONFIG_UM_FEATURE_WEBHOOKS=n
CONFIG_UM_FEATURE_MQTT=n
CONFIG_UM_FEATURE_OPENTHERM=n
CONFIG_UM_FEATURE_RF433=n
CONFIG_UM_FEATURE_ONEWIRE=n
CONFIG_UM_FEATURE_ALARM=n
CONFIG_UM_FEATURE_ADC=n
CONFIG_UM_FEATURE_NTC1=n
CONFIG_UM_FEATURE_NTC2=n
CONFIG_UM_FEATURE_AI1=n
CONFIG_UM_FEATURE_AI2=n
CONFIG_UM_FEATURE_OPENCOLLECTORS=n
CONFIG_UM_FEATURE_OC1=n
CONFIG_UM_FEATURE_OC2=n
CONFIG_UM_FEATURE_BUZZER=n
CONFIG_UM_FEATURE_INPUTS=n
CONFIG_UM_FEATURE_INP1=n
CONFIG_UM_FEATURE_INP2=n
CONFIG_UM_FEATURE_INP3=n
CONFIG_UM_FEATURE_INP4=n
CONFIG_UM_FEATURE_INP5=n
CONFIG_UM_FEATURE_INP6=n
CONFIG_UM_FEATURE_OUTPUTS=n
CONFIG_UM_FEATURE_OUT1=n
CONFIG_UM_FEATURE_OUT2=n
CONFIG_UM_FEATURE_OUT3=n
CONFIG_UM_FEATURE_OUT4=n
CONFIG_UM_FEATURE_OUT5=n
CONFIG_UM_FEATURE_OUT6=n
CONFIG_UM_FEATURE_OUT7=n
CONFIG_UM_FEATURE_OUT8=n
```

## sdkconfig.defaults.esp32
```kconfig
CONFIG_SDSPI_CS_GPIO=32 
CONFIG_SDSPI_DETECT_GPIO=33
CONFIG_I2C_MASTER_SDA_GPIO=23
CONFIG_I2C_MASTER_SCL_GPIO=22
CONFIG_UM_CFG_OT_IN_GPIO=26
CONFIG_UM_CFG_OT_OUT_GPIO=25
CONFIG_UM_CFG_RF433_DATA_GPIO=27
CONFIG_UM_CFG_ONEWIRE_GPIO=17
CONFIG_UM_CFG_ALARM_GPIO=13
CONFIG_UM_CFG_NTC1_ADC_CHANNEL=36
CONFIG_UM_CFG_NTC2_ADC_CHANNEL=39
CONFIG_UM_CFG_AI1_ADC_CHANNEL=34
CONFIG_UM_CFG_AI2_ADC_CHANNEL=35
CONFIG_UM_CFG_OC1_GPIO=14
CONFIG_UM_CFG_OC2_GPIO=12
CONFIG_UM_CFG_BUZZER_GPIO=15
CONFIG_UM_CFG_PCF_INT=16
CONFIG_UM_CFG_INP1_INDEX=1 
CONFIG_UM_CFG_INP2_INDEX=2
CONFIG_UM_CFG_INP3_INDEX=3
CONFIG_UM_CFG_INP4_INDEX=4
CONFIG_UM_CFG_INP5_INDEX=5
CONFIG_UM_CFG_INP6_INDEX=6
CONFIG_UM_CFG_OUT1_INDEX=1
CONFIG_UM_CFG_OUT2_INDEX=2
CONFIG_UM_CFG_OUT3_INDEX=3
CONFIG_UM_CFG_OUT4_INDEX=4
CONFIG_UM_CFG_OUT5_INDEX=5
CONFIG_UM_CFG_OUT6_INDEX=6
CONFIG_UM_CFG_OUT7_INDEX=7
CONFIG_UM_CFG_OUT8_INDEX=8
```
