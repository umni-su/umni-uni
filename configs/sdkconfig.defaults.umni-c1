## configs/sdkconfig.defaults.umni-c1
```kconfig
CONFIG_UM_FEATURE_ETHERNET=y
CONFIG_ETHERNET_INTERNAL_SUPPORT=n
CONFIG_ETHERNET_SPI_SUPPORT=y
CONFIG_ETHERNET_SPI_DEV0_W5500=y
CONFIG_ETHERNET_SPI_DEV1_NONE=y
CONFIG_ETHERNET_SPI_HOST=1
CONFIG_ETHERNET_SPI_SCLK_GPIO=18
CONFIG_ETHERNET_SPI_MOSI_GPIO=21
CONFIG_ETHERNET_SPI_MISO_GPIO=19
CONFIG_ETHERNET_SPI_CLOCK_MHZ=16
CONFIG_ETHERNET_SPI_CS0_GPIO=5
CONFIG_ETHERNET_SPI_INT0_GPIO=4

CONFIG_UM_FEATURE_OPENCOLLECTORS=y
CONFIG_UM_FEATURE_OC1=y
CONFIG_UM_FEATURE_OC2=y
CONFIG_UM_CFG_OC1_GPIO=14
CONFIG_UM_CFG_OC2_GPIO=12

CONFIG_UM_FEATURE_BUZZER=y
CONFIG_UM_CFG_BUZZER_GPIO=15

CONFIG_UM_FEATURE_ALARM=y
CONFIG_UM_CFG_ALARM_GPIO=13

CONFIG_UM_FEATURE_INPUTS=y
CONFIG_UM_FEATURE_INP1=y
CONFIG_UM_FEATURE_INP2=y
CONFIG_UM_FEATURE_INP3=y
CONFIG_UM_FEATURE_INP4=y
CONFIG_UM_FEATURE_INP5=y
CONFIG_UM_FEATURE_INP6=y
CONFIG_UM_FEATURE_OUTPUTS=y
CONFIG_UM_FEATURE_OUT1=y
CONFIG_UM_FEATURE_OUT2=y
CONFIG_UM_FEATURE_OUT3=y
CONFIG_UM_FEATURE_OUT4=y
CONFIG_UM_FEATURE_OUT5=y
CONFIG_UM_FEATURE_OUT6=y
CONFIG_UM_FEATURE_OUT7=y
CONFIG_UM_FEATURE_OUT8=y
CONFIG_UM_CFG_OUT1_INDEX=0
CONFIG_UM_CFG_OUT2_INDEX=1
CONFIG_UM_CFG_OUT3_INDEX=2
CONFIG_UM_CFG_OUT4_INDEX=3
CONFIG_UM_CFG_OUT5_INDEX=5
CONFIG_UM_CFG_OUT6_INDEX=4
CONFIG_UM_CFG_OUT7_INDEX=6
CONFIG_UM_CFG_OUT8_INDEX=7

CONFIG_UM_FEATURE_SDCARD=y
CONFIG_UM_CFG_SDCARD_SPI_HOST=1
CONFIG_UM_CFG_SDCARD_CS_GPIO=32 
CONFIG_UM_CFG_SDCARD_DETECT_GPIO=33
CONFIG_UM_CFG_SDCARD_SCLK_GPIO=18
CONFIG_UM_CFG_SDCARD_MOSI_GPIO=21
CONFIG_UM_CFG_SDCARD_MISO_GPIO=19

CONFIG_UM_FEATURE_OPENTHERM=y
CONFIG_UM_CFG_OT_IN_GPIO=26
CONFIG_UM_CFG_OT_OUT_GPIO=25

CONFIG_UM_FEATURE_WEBSERVER=y

CONFIG_UM_FEATURE_ONEWIRE=y
CONFIG_UM_CFG_ONEWIRE_GPIO=17
```
